## ADC/Kconfig
```kconfig
#
# ADC device configuration
#

config S3C2410_ADC
	bool "MOBO ADC"
	help
	  ADC DEVELOP WITH MOBO
```

## Kconfig
```kconfig
#
# MOBO
#

menuconfig MOBO
	tristate "Driver By MoBo"
	---help---
	  Dallas' 1-wire bus is useful to connect slow 1-pin devices
	  such as iButtons and thermal sensors.

	  If you want W1 support, you should say Y here.

	  This W1 support can also be built as a module.  If so, the module
	  will be called wire.
	  
if MOBO
source "drivers/mobo/led_switch/Kconfig"
source "drivers/mobo/ADC/Kconfig"
endif 
```

## led_switch/Kconfig
```kconfig
#
# LED device configuration
#

config S3C2410_lLED_SWITCH
	bool "MOBO LED SWITCH"
	help
	  LED SWITCH DEVELOP WITH MOBO
```
